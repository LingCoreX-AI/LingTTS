## examples/hello/main/Kconfig.projbuild
```kconfig
menu "LingTTS hello"
config HELLO_BCLK
    int "I2S BCLK GPIO"
    default 15
config HELLO_WS
    int "I2S LRCK GPIO"
    default 16
config HELLO_DOUT
    int "I2S DATA GPIO"
    default 7
config HELLO_VOLUME
    int "Playback volume percent"
    range 1 100
    default 30
config HELLO_DMA_MS
    int "I2S DMA buffer (ms): must exceed the synthesis time of one block, or playback gaps (pops) between blocks"
    range 100 1000
    default 400
config HELLO_FORCE_INTERNAL
    bool "Use LINGTTS_MEM_INTERNAL even if PSRAM is present"
    default n
endmenu
```

## examples/hello/sdkconfig.defaults
```kconfig
CONFIG_IDF_TARGET="esp32s3"
CONFIG_ESPTOOLPY_FLASHSIZE_4MB=y
CONFIG_ESPTOOLPY_FLASHMODE_QIO=y
CONFIG_ESPTOOLPY_FLASHFREQ_80M=y
CONFIG_PARTITION_TABLE_CUSTOM=y
CONFIG_PARTITION_TABLE_CUSTOM_FILENAME="partitions.csv"
CONFIG_ESP_DEFAULT_CPU_FREQ_MHZ_240=y
CONFIG_COMPILER_OPTIMIZATION_PERF=y
CONFIG_ESP_MAIN_TASK_STACK_SIZE=16384
CONFIG_ESP32S3_DATA_CACHE_64KB=y
CONFIG_ESP32S3_DATA_CACHE_LINE_64B=y
CONFIG_ESP32S3_INSTRUCTION_CACHE_32KB=y
# 八线 PSRAM（N16R8 一类）；没有 PSRAM 或初始化失败时照常启动，程序自动改用 LINGTTS_MEM_INTERNAL
CONFIG_SPIRAM=y
CONFIG_SPIRAM_MODE_OCT=y
CONFIG_SPIRAM_SPEED_80M=y
CONFIG_SPIRAM_IGNORE_NOTFOUND=y
CONFIG_SPIRAM_USE_MALLOC=y
CONFIG_SPIRAM_MALLOC_ALWAYSINTERNAL=2048
# esp-nn：S3 汇编版，逐位精确的 requant
CONFIG_NN_OPTIMIZED=y
# CONFIG_NN_SKIP_NUDGE is not set
```

## examples/web_demo/main/Kconfig.projbuild
```kconfig
menu "LingTTS demo"
config DEMO_AP_SSID
    string "Hotspot name"
    default "LingTTS-Demo"
config DEMO_AP_PASSWORD
    string "Hotspot password (8 to 63 ASCII characters)"
    default "lingtts-demo"
config DEMO_BCLK
    int "I2S BCLK GPIO"
    default 15
config DEMO_WS
    int "I2S LRCK GPIO"
    default 16
config DEMO_DOUT
    int "I2S DATA GPIO"
    default 7
config DEMO_VOLUME
    int "Playback volume percent"
    range 1 100
    default 30
endmenu
```
